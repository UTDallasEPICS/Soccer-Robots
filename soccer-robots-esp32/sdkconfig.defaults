## soccer-robots-esp32/sdkconfig.defaults
```kconfig
CONFIG_ESP_CONSOLE_USB_CDC=y
CONFIG_ESP_CONSOLE_UART_NONE=y

CONFIG_USB_ENABLED=y
CONFIG_TINYUSB_CDC_ENABLED=y
CONFIG_USB_DEVICE_VID=0x303A
CONFIG_USB_DEVICE_PID=0x1001
```
